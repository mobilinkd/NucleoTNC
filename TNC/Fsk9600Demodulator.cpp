// Copyright 2020 Rob Riggs <rob@mobilinkd.com>
// All rights reserved.

#include "Fsk9600Demodulator.hpp"
#include "Goertzel.h"
#include "AudioInput.hpp"
#include "GPIO.hpp"
#include "Log.h"

namespace mobilinkd { namespace tnc {

hdlc::IoFrame* Fsk9600Demodulator::operator()(const q15_t* samples)
{
    hdlc::IoFrame* result = nullptr;

    auto filtered = demod_filter.filter(const_cast<q15_t* >(samples));

    for (size_t i = 0; i != ADC_BLOCK_SIZE; ++i)
    {
        auto sample = filtered[i];

        bool bit = sample >= 0;
        auto pll = pll_(bit);

        if (pll.sample)
        {
            locked_ = pll.locked;

            // We will only ever get one frame because there are
            // not enough bits in a block for more than one.
            if (result) {
                auto tmp = hdlc_decoder_(nrzi_.decode(lfsr_(bit)), locked_);
                if (tmp) hdlc::release(tmp);
            } else {
                result = hdlc_decoder_(nrzi_.decode(lfsr_(bit)), locked_);
#ifdef KISS_LOGGING
                if (result) {
                    INFO("samples = %ld, mean = %d, dev = %d",
                        snr_.samples, int(snr_.mean), int(snr_.stdev()));
                    INFO("SNR = %dmB", int(snr_.SNR() * 100.0f));
                    snr_.reset();
                }
#endif
            }

#ifdef KISS_LOGGING
            if (hdlc_decoder_.active())
            {
                if (!decoding_)
                {
                    snr_.reset();
                    decoding_ = true;
                }
                snr_.capture(float(abs(sample)));
            } else {
                decoding_ = false;
            }
#endif
        }

    }
    return result;
}

/*
 * Return twist as a the difference in dB between mark and space.  The
 * expected values are about 0dB for discriminator output and about 5.5dB
 * for de-emphasized audio.
 */
float Fsk9600Demodulator::readTwist()
{
    TNC_DEBUG("enter Fsk9600Demodulator::readTwist");

    float g120 = 0.0f;
    float g4800 = 0.0f;

    GoertzelFilter<ADC_BLOCK_SIZE, SAMPLE_RATE> gf120(120.0, 0);
    GoertzelFilter<ADC_BLOCK_SIZE, SAMPLE_RATE> gf4800(4800.0, 0);

    const uint32_t AVG_SAMPLES = 160;

    startADC(416, ADC_BLOCK_SIZE);

    for (uint32_t i = 0; i != AVG_SAMPLES; ++i)
    {
        uint32_t count = 0;
        while (count < ADC_BLOCK_SIZE)
        {
            osEvent evt = osMessageGet(adcInputQueueHandle, osWaitForever);
            if (evt.status != osEventMessage)
                continue;

            auto block = (audio::adc_pool_type::chunk_type*) evt.value.p;
            uint16_t* data = (uint16_t*) block->buffer;
            gf120(data, ADC_BLOCK_SIZE);
            gf4800(data, ADC_BLOCK_SIZE);

            audio::adcPool.deallocate(block);

            count += ADC_BLOCK_SIZE;
        }

        g120 += (gf120 / count);
        g4800 += (gf4800 / count);

        gf120.reset();
        gf4800.reset();
    }

    IDemodulator::stopADC();

    g120 = 10.0f * log10f(g120 / AVG_SAMPLES);
    g4800 = 10.0f * log10f(g4800 / AVG_SAMPLES);

    auto result = g120 - g4800;

    INFO("9600 Twist = %d / 100 (%d - %d)", int(result * 100), int(g120 * 100),
        int(g4800 * 100));

    TNC_DEBUG("exit Fsk9600Demodulator::readTwist");
    return result;
}

uint32_t Fsk9600Demodulator::readBatteryLevel()
{
#ifndef NUCLEOTNC
    TNC_DEBUG("enter Fsk9600Demodulator::readBatteryLevel");

    ADC_ChannelConfTypeDef sConfig;

    sConfig.Channel = ADC_CHANNEL_VREFINT;
    sConfig.Rank = ADC_REGULAR_RANK_1;
    sConfig.SingleDiff = ADC_SINGLE_ENDED;
    sConfig.SamplingTime = ADC_SAMPLETIME_247CYCLES_5;
    sConfig.OffsetNumber = ADC_OFFSET_NONE;
    sConfig.Offset = 0;
    if (HAL_ADC_ConfigChannel(&hadc1, &sConfig) != HAL_OK)
        CxxErrorHandler();

    htim6.Init.Period = 48000;
    if (HAL_TIM_Base_Init(&htim6) != HAL_OK) CxxErrorHandler();

    if (HAL_TIM_Base_Start(&htim6) != HAL_OK)
        CxxErrorHandler();

    if (HAL_ADC_Start(&hadc1) != HAL_OK) CxxErrorHandler();
    if (HAL_ADC_PollForConversion(&hadc1, 3) != HAL_OK) CxxErrorHandler();
    auto vrefint = HAL_ADC_GetValue(&hadc1);
    if (HAL_ADC_Stop(&hadc1) != HAL_OK) CxxErrorHandler();

    // Disable battery charging while measuring battery voltage.
    auto usb_ce = gpio::USB_CE::get();
    gpio::USB_CE::on();

    gpio::BAT_DIVIDER::off();
    HAL_Delay(1);

    sConfig.Channel = BATTERY_ADC_CHANNEL;
    if (HAL_ADC_ConfigChannel(&BATTERY_ADC_HANDLE, &sConfig) != HAL_OK)
        CxxErrorHandler();

    uint32_t vbat = 0;
    if (HAL_ADC_Start(&BATTERY_ADC_HANDLE) != HAL_OK) CxxErrorHandler();
    for (size_t i = 0; i != 8; ++i)
    {
        if (HAL_ADC_PollForConversion(&BATTERY_ADC_HANDLE, 1) != HAL_OK) CxxErrorHandler();
        vbat += HAL_ADC_GetValue(&BATTERY_ADC_HANDLE);
    }

    vbat /= 8;

    if (HAL_ADC_Stop(&BATTERY_ADC_HANDLE) != HAL_OK) CxxErrorHandler();
    if (HAL_TIM_Base_Stop(&htim6) != HAL_OK)
        CxxErrorHandler();

    gpio::BAT_DIVIDER::on();

    // Restore battery charging state.
    if (!usb_ce) gpio::USB_CE::off();

    INFO("Vref = %lu", vrefint);
    INFO("Vbat = %lu (raw)", vbat);

    // Order of operations is important to avoid underflow.
    vbat *= 6600;
    vbat /= (VREF + 1);

    uint32_t vref = ((vrefint * 3300) + (VREF / 2)) / VREF;

    INFO("Vref = %lumV", vref)
    INFO("Vbat = %lumV", vbat);

    TNC_DEBUG("exit Fsk9600Demodulator::readBatteryLevel");
    return vbat;
#else
    return 0;
#endif
}

const Fsk9600Demodulator::bpf_bank_type Fsk9600Demodulator::bpf_bank = {{
    // -3dB
    {{
            1,     0,     0,     0,     0,     0,    -1,    -1,    -1,    -1,     0,     0,
            0,     0,     1,     2,     2,     3,     2,     2,     0,     0,    -2,    -3,
           -4,    -4,    -3,    -1,     3,     9,    17,    27,    38,    48,    58,    65,
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            0,     0,    -1,    -1,    -1,    -1,     0,     0,     0,     0,     0,     1
    }},
    // -2dB
    {{
            1,     0,     0,     0,     0,    -1,    -1,    -1,    -1,    -1,    -1,    -1,
            0,     0,     1,     1,     2,     2,     1,     0,     0,    -1,    -3,    -5,
           -6,    -6,    -5,    -1,     3,    10,    20,    31,    42,    54,    64,    72,
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           -1,    -1,    -1,    -1,    -1,    -1,    -1,     0,     0,     0,     0,     1
    }},
    // -1dB
    {{
            1,     0,     0,     0,     0,    -1,    -1,    -2,    -2,    -2,    -2,    -1,
           -1,     0,     0,     0,     1,     1,     0,     0,    -1,    -3,    -5,    -7,
           -8,    -8,    -6,    -2,     3,    11,    22,    34,    48,    60,    72,    80,
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           -1,    -2,    -2,    -2,    -2,    -1,    -1,     0,     0,     0,     0,     1
    }},
    // 0dB
    {{
            1,     0,     0,     0,    -1,    -1,    -2,    -2,    -3,    -3,    -3,    -2,
           -2,    -1,     0,     0,     0,     0,     0,    -1,    -3,    -5,    -7,    -9,
          -10,   -10,    -7,    -3,     3,    13,    25,    39,    53,    68,    80,    88,
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           -2,    -3,    -3,    -3,    -2,    -2,    -1,    -1,     0,     0,     0,     1
    }},
    // 1dB
    {{
            1,     1,     0,     0,    -1,    -2,    -2,    -3,    -3,    -4,    -4,    -3,
           -3,    -2,    -1,    -1,    -1,    -1,    -1,    -3,    -5,    -7,    -9,   -11,
          -12,   -12,    -9,    -4,     3,    14,    28,    43,    60,    76,    89,    98,
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           -3,    -4,    -4,    -3,    -3,    -2,    -2,    -1,     0,     0,     1,     1
    }},
    // 2dB
    {{
            1,     1,     0,     0,    -1,    -2,    -3,    -4,    -4,    -5,    -5,    -4,
           -4,    -3,    -3,    -2,    -2,    -2,    -3,    -5,    -7,    -9,   -12,   -14,
          -15,   -14,   -11,    -5,     3,    15,    31,    49,    67,    85,   100,   109,
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           -4,    -5,    -5,    -4,    -4,    -3,    -2,    -1,     0,     0,     1,     1
    }},
    // 3dB
    {{
            2,     1,     0,     0,    -1,    -3,    -4,    -4,    -5,    -6,    -6,    -5,
           -5,    -4,    -4,    -3,    -3,    -4,    -5,    -7,    -9,   -12,   -15,   -17,
          -18,   -17,   -13,    -6,     3,    17,    35,    55,    75,    95,   111,   121,
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           -5,    -6,    -6,    -5,    -4,    -4,    -3,    -1,     0,     0,     1,     2
    }},
    // 4dB
    {{
            2,     1,     0,    -1,    -2,    -3,    -4,    -5,    -6,    -7,    -7,    -7,
           -6,    -6,    -5,    -5,    -5,    -6,    -7,    -9,   -12,   -15,   -18,   -20,
          -21,   -20,   -16,    -8,     3,    19,    39,    61,    85,   107,   125,   135,
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           -7,    -7,    -7,    -6,    -5,    -4,    -3,    -2,    -1,     0,     1,     2
    }},
    // 5dB
    {{
            2,     1,     0,    -1,    -2,    -4,    -5,    -6,    -7,    -8,    -8,    -8,
           -8,    -8,    -7,    -7,    -7,    -8,    -9,   -11,   -14,   -18,   -21,   -24,
          -25,   -23,   -19,    -9,     3,    21,    44,    69,    95,   119,   139,   151,
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           -8,    -8,    -8,    -7,    -6,    -5,    -4,    -2,    -1,     0,     1,     2
    }},
    // 6dB
    {{
            2,     1,     0,    -1,    -3,    -4,    -6,    -7,    -9,   -10,   -10,   -10,
          -10,    -9,    -9,    -9,    -9,   -10,   -12,   -14,   -18,   -21,   -25,   -28,
          -29,   -27,   -22,   -11,     3,    24,    49,    77,   107,   134,   156,   168,
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          -10,   -10,   -10,    -9,    -7,    -6,    -4,    -3,    -1,     0,     1,     2
    }},
    // 7dB
    {{
            3,     1,     0,    -1,    -3,    -5,    -7,    -9,   -10,   -11,   -12,   -12,
          -12,   -11,   -11,   -11,   -11,   -12,   -14,   -17,   -21,   -26,   -30,   -33,
          -34,   -32,   -25,   -13,     3,    27,    55,    87,   120,   150,   174,   188,
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          -12,   -12,   -11,   -10,    -9,    -7,    -5,    -3,    -1,     0,     1,     3
    }},
    // 8dB
    {{
            3,     1,     0,    -2,    -4,    -6,    -8,   -10,   -12,   -13,   -14,   -14,
          -14,   -14,   -13,   -13,   -14,   -15,   -17,   -21,   -25,   -30,   -35,   -38,
          -39,   -36,   -29,   -16,     3,    30,    62,    97,   134,   168,   195,   209,
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          -14,   -14,   -13,   -12,   -10,    -8,    -6,    -4,    -2,     0,     1,     3
    }},
    // 9dB
    {{
            3,     2,     0,    -2,    -4,    -7,    -9,   -12,   -14,   -15,   -16,   -17,
          -17,   -16,   -16,   -16,   -17,   -18,   -21,   -25,   -30,   -35,   -40,   -44,
          -45,   -42,   -33,   -18,     3,    33,    69,   109,   151,   189,   218,   234,
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          -17,   -16,   -15,   -14,   -12,    -9,    -7,    -4,    -2,     0,     2,     3
    }}
}};

}} // mobilinkd::tnc

